## Project 2 - GPIO Whackamole game/Unarchived Source/whackamole/package_stuff/whackamole/Config.in
```kconfig
config BR2_PACKAGE_WHACKAMOLE
        bool "whackamole"
        depends on BR2_PACKAGE_LIBGPIOD
        select BR2_PACKAGE_GDB
        help
          A small game of whackamole. Developed
          by Noman Noor. (BETA)

          http://nomi.github.io

          config BR2_PACKAGE_WORMS
```
